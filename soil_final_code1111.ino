#define BLYNK_TEMPLATE_ID "TMPL6PMo7FmTh"
#define BLYNK_TEMPLATE_NAME "Mr Soil"
#define BLYNK_AUTH_TOKEN "kUTjQRft4OOHCqG6FfdyOINFr-Ae5FC2"

#define BLYNK_PRINT Serial
#include <WiFi.h>
#include <BlynkSimpleEsp32.h>
#include <HardwareSerial.h>
#include <Wire.h>
#include <Adafruit_GFX.h>
#include <Adafruit_SSD1306.h>
#include <HTTPClient.h>
#include "DHT.h"  // Added DHT library

// WiFi credentials
char ssid[] = "Mr.Soil";
char pass[] = "Mr.Soil@Aquinas";

// Telegram Bot credentials
#define TELEGRAM_BOT_TOKEN "8274242875:AAGSUs8sEYtFFoIJ-44Jt5Q1xi6tsa1xfYs"
#define CHAT_ID "5289786277"

// OLED configuration
#define SCREEN_WIDTH 128
#define SCREEN_HEIGHT 64
#define OLED_RESET -1
#define OLED_SDA 21
#define OLED_SCL 22
Adafruit_SSD1306 display(SCREEN_WIDTH, SCREEN_HEIGHT, &Wire, OLED_RESET);

// RS-485 configuration
#define DE_PIN 4
#define RE_PIN 5
#define SENSOR_ADDR 0x01
#define BAUD_RATE 4800
HardwareSerial rs485(2);  // RX = 16, TX = 17

const byte queryData[] = {0x01, 0x03, 0x00, 0x00, 0x00, 0x07, 0x04, 0x08};
float moisture, temperature, ec, ph;
uint16_t N, P, K;

BlynkTimer timer;

// DHT22 configuration - ADDED
#define DHTPIN 14       // Changed to GPIO14 as discussed for DHT22 pin
#define DHTTYPE DHT22
DHT dht(DHTPIN, DHTTYPE);

// --- Logo bitmap array ---
static const uint8_t PROGMEM Dhoni[] = {
  0x00, 0x00, 0x00, 0x00, 0x00, 0x00, 0x00, 0x00, 0x00, 0x00, 0x00, 0x00, 0x00, 0x00, 0x00, 0x00,
  0x00, 0x00, 0x00, 0x00, 0x00, 0x00, 0x00, 0x00, 0x00, 0x00, 0x00, 0x00, 0x00, 0x00, 0x00, 0x00,
  0x00, 0x00, 0x00, 0x00, 0x00, 0x00, 0x00, 0x00, 0x00, 0x00, 0x00, 0x00, 0x00, 0x00, 0x00, 0x00,
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  0x00, 0x00, 0x00, 0x00, 0x00, 0x00, 0x00, 0x00, 0x00, 0x00, 0x00, 0x00, 0x00, 0x00, 0x00, 0x00
  // (your full logo array data here)
};

void setup() {
  Serial.begin(9600);

  WiFi.begin(ssid, pass);
  Serial.print("Connecting to WiFi");
  while (WiFi.status() != WL_CONNECTED) {
    delay(500);
    Serial.print(".");
  }
  Serial.println("\n✅ WiFi connected!");
  Serial.println("IP address: " + WiFi.localIP().toString());

  Blynk.begin(BLYNK_AUTH_TOKEN, ssid, pass);

  rs485.begin(BAUD_RATE, SERIAL_8N1, 16, 17);
  pinMode(DE_PIN, OUTPUT);
  pinMode(RE_PIN, OUTPUT);
  digitalWrite(DE_PIN, LOW);
  digitalWrite(RE_PIN, LOW);

  Wire.begin(OLED_SDA, OLED_SCL);
  if (!display.begin(SSD1306_SWITCHCAPVCC, 0x3C)) {
    Serial.println(F("❌ OLED not found"));
    while (true);
  }

  // Initialize DHT sensor - ADDED
  dht.begin();

  // --- Show logo first ---
  display.clearDisplay();
  display.drawBitmap(0, 0, Dhoni, SCREEN_WIDTH, SCREEN_HEIGHT, SSD1306_WHITE);
  display.display();
  delay(3000); // show logo for 3 seconds

  // --- Show startup text ---
  display.clearDisplay();
  display.setTextSize(1);
  display.setTextColor(SSD1306_WHITE);
  display.setCursor(0, 0);
  display.display();

  sendTelegramMessage("🌱 Soil Monitoring System Started");
  timer.setInterval(1000L, sendSensorData);  // every 1 second
}

void loop() {
  Blynk.run();
  timer.run();
  readSensorData();
}
// ---------------- SENSOR FUNCTIONS ----------------
void sendSensorData() {

  display.clearDisplay();
  display.setCursor(0, 0);

  // Read DHT22 data - ADDED
  float dhtTemp = dht.readTemperature();
  float dhtHum = dht.readHumidity();

  String weatherStatus = "Unknown";
  if (!isnan(dhtTemp) && !isnan(dhtHum)) {
    weatherStatus = getWeatherWord(dhtTemp, dhtHum);
  }

  Serial.printf("Moisture: %.2f %%\n", moisture);
  Serial.printf("Temperature: %.2f °C\n", temperature);
  Serial.printf("EC: %.2f μS/cm\n", ec);
  Serial.printf("pH: %.2f\n", ph);
  Serial.printf("N: %d\n", N);
  Serial.printf("P: %d\n", P);
  Serial.printf("K: %d\n", K);

  // Print soil data + weather to OLED
  display.printf("Moist: %.2f %%\n", moisture);
  display.printf("Temp : %.2f C\n", temperature);
  display.printf("EC   : %.0f uS/cm\n", ec);
  display.printf("pH   : %.2f\n", ph);
  display.printf("N    : %d\n", N);
  display.printf("P    : %d\n", P);
  display.printf("K    : %d\n", K);
  display.printf("Weather: %s\n", weatherStatus.c_str());
  display.display();

  Blynk.virtualWrite(V1, moisture);
  Blynk.virtualWrite(V0, temperature);
  Blynk.virtualWrite(V6, ec);
  Blynk.virtualWrite(V2, ph);
  Blynk.virtualWrite(V3, N);
  Blynk.virtualWrite(V4, P);
  Blynk.virtualWrite(V5, K);
  // Could also send DHT temp/humidity to other virtual pins if desired

  String message = "⚠️ Soil Alert:\n";
  message += "Moisture: " + String(moisture, 2) + "%\n";
  message += "Temp: " + String(temperature, 2) + "°C\n";
  message += "EC: " + String(ec, 2) + "uS/cm\n";
  message += "pH: " + String(ph, 2) + "\n";
  message += "N: " + String(N) + "\n";
  message += "P: " + String(P) + "\n";
  message += "K: " + String(K) + "\n";

  // Add weather info to Telegram message - ADDED
  if (!isnan(dhtTemp) && !isnan(dhtHum)) {
    message += "Weather: " + weatherStatus + " (" + String(dhtTemp, 1) + "°C, " + String(dhtHum, 0) + "%)\n";
  } else {
    message += "Weather: Sensor error\n";
  }

  sendTelegramMessage(message);
}

void sendTelegramMessage(String message) {
  if (WiFi.status() == WL_CONNECTED) {
    HTTPClient http;
    String url = "https://api.telegram.org/bot" + String(TELEGRAM_BOT_TOKEN) + "/sendMessage";
    String payload = "chat_id=" + String(CHAT_ID) + "&text=" + message;

    Serial.println("Sending Telegram message...");
    http.begin(url);
    http.addHeader("Content-Type", "application/x-www-form-urlencoded");
    int httpCode = http.POST(payload);

    if (httpCode > 0) {
      Serial.println("✅ Telegram sent. Code: " + String(httpCode));
      String response = http.getString();
      Serial.println("Response: " + response);
    } else {
      Serial.println("❌ Telegram failed. Error: " + http.errorToString(httpCode));
    }
    http.end();
  } else {
    Serial.println("❌ WiFi not connected");
  }
}
void readSensorData() {
  byte response[21];
  clearReceiveBuffer();

  // Transmit mode
  digitalWrite(DE_PIN, HIGH);
  digitalWrite(RE_PIN, HIGH);
  delay(2);
  rs485.write(queryData, sizeof(queryData));
  rs485.flush();
  delay(2);
  // Receive mode
  digitalWrite(DE_PIN, LOW);
  digitalWrite(RE_PIN, LOW);

  delay(300); // Wait for response

  int i = 0;
  while (rs485.available() && i < 21) {
    response[i++] = rs485.read();
  }

  if (i >= 19) {  // Minimum expected response length
    moisture    = (response[3] << 8 | response[4]) / 10.0;
    temperature = (response[5] << 8 | response[6]) / 10.0;
    ec          = (response[7] << 8 | response[8]);
    ph          = (response[9] << 8 | response[10]) / 10.0;
    N         = (response[11] << 8 | response[12]);
    P       = (response[13] << 8 | response[14]);
    K        = (response[15] << 8 | response[16]);

    Serial.print("moisture :");
    Serial.println(moisture);
    Serial.print("temperature :");
    Serial.println(temperature);
    Serial.print("ec :");
    Serial.println(ec);
    Serial.print("ph :");
    Serial.println(ph);
    Serial.print("n :");
    Serial.println(N);
    Serial.print("p :");
    Serial.println(P);
    Serial.print("k :");
    Serial.println(K);
    
  } else {
    Serial.println("Invalid response or timeout.");
  }
  delay(1000);
}


// Weather evaluation function - ADDED
String getWeatherWord(float t, float h) {
  if (t > 30 && h < 50) return "Sunny";
  else if (t >= 25 && t <= 32 && h >= 70) return "Humid";
  else if (t > 25 && h >= 50 && h <= 70) return "Warm";
  else if (t < 25 && h > 70) return "Rainy";
  else if (t >= 20 && t <= 25 && h >= 40 && h <= 60) return "Mild";
  else if (t < 20 && h > 60) return "Cool";
  else if (t < 15) return "Cold";
  else return "Unknown";
}
void clearReceiveBuffer() {
  while (rs485.available()) rs485.read();
}
